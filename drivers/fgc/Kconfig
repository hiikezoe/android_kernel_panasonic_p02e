## drivers/fgc/Kconfig
```kconfig
menu "Fuel Gauge Device Driver"

config BATTERY_DEGRADATION_JUDGEMENT
        tristate "Voltage Supervision"
        help
   	  		Battery degradation judgement in voltage supervision.

endmenu
```

## drivers/mmtuner/Kconfig
```kconfig
menu "PMC MB86A35 MM Tuner"
    config MMTUNER_DRIVER
    tristate "PMC MB86A35 MM Tuner"
    help
        This enables the PMC MB86A35 MM Tuner for Laputa

endmenu
```

## drivers/shdma/Kconfig
```kconfig
    config SHDMA_DRIVER
    tristate "shdma"
    default m
    help
        This enables the shdma
```

## drivers/temperature/Kconfig
```kconfig
comment "Temperature Sensor"
config TEMPERATURE_DRIVER
       tristate "TWL6030 temperature sensor support"
       depends on I2C=y
       help
         If you say yes here you get support for 
         temperature sensors TWL6030.
```

## drivers/wchg/Kconfig
```kconfig
comment "Wireless Charging"
config WCHG_DRIVER
       tristate "Wireless Charging support"
       help
         If you say yes here you get support for 
         Wireless Charging.
```
